## config/boards/arm/17pad/Kconfig.board
```kconfig
# Copyright (c) 2020 The ZMK Contributors
# SPDX-License-Identifier: MIT

config BOARD_17pad
	bool "17pad"
	depends on SOC_NRF52840_QIAA
```

## config/boards/arm/key66/Kconfig.board
```kconfig
# Maker Diary nrf52840 M.2 board configuration

# Copyright (c) 2020 The ZMK Contributors
# SPDX-License-Identifier: MIT

config BOARD_KEY66
	bool "key66"
	depends on SOC_NRF52840_QIAA
```

## config/boards/shields/pad17/Kconfig.defconfig
```kconfig
# Copyright (c) 2020 The ZMK Contributors
# SPDX-License-Identifier: MIT

if SHIELD_PAD17

config ZMK_KEYBOARD_NAME
	default "pad17"

endif
```

## config/boards/shields/pad17/Kconfig.shield
```kconfig
# Copyright (c) 2020 The ZMK Contributors
# SPDX-License-Identifier: MIT

config SHIELD_PAD17
	def_bool $(shields_list_contains,pad17)
```

## config/west.yml
```yaml
manifest:
  remotes:
    - name: zmkfirmware
      url-base: https://github.com/zmkfirmware
    - name: q123321a
      url-base: https://github.com/q123321a
  projects:
    - name: zmkfirmware
      remote: q123321a
      revision: main
      import: app/west.yml
  self:
    path: config
```
